## firmware/display/main/Kconfig.projbuild
```kconfig
menu "Display board"

    choice DISPLAY_BOARD
        prompt "Display board / firmware variant"
        default DISPLAY_BOARD_8048S050C if IDF_TARGET_ESP32S3
        default DISPLAY_BOARD_2432S032 if IDF_TARGET_ESP32

        config DISPLAY_BOARD_8048S050C
            bool "ESP32-8048S050C (ESP32-S3, 800x480 RGB, GT911)"
            depends on IDF_TARGET_ESP32S3

        config DISPLAY_BOARD_2432S032
            bool "ESP32-2432S032C (ESP32, 320x240 SPI ST7789, GT911) - compact UI"
            depends on IDF_TARGET_ESP32
    endchoice
endmenu

menu "Sunton ESP32-S3 based display LVGL Package config"

    config SUNTON_ESP32_DOUBLE_FB
        bool "Use Double Frame Buffer"
        default y

    config SUNTON_ESP32_DOUBLE_FB_TEARING
        bool "Avoid tearing effect"
        depends on SUNTON_ESP32_DOUBLE_FB
        default y

    config SUNTON_ESP32_USE_BOUNCE_BUFFER
        bool "Use bounce buffer"
        depends on SUNTON_ESP32_DOUBLE_FB=n
        default n

    config LVGL_TASK_MAX_DELAY_MS
        int "LVGL Port Task max delay in MS"
        default 500

    config LVGL_TASK_MIN_DELAY_MS
        int "LVGL Port Task min delay in MS"
        default 1

    config LVGL_TASK_STACK_SIZE
        int "LVGL Port Task stack size in KB"
        default 8

    config LVGL_TASK_PRIORITY
        int "LVGL Port Task prio"
        default 3
endmenu
```
